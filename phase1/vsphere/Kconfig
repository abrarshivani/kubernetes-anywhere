## phase1/vsphere/Kconfig
```kconfig
menu "vSphere configuration"

config phase1.vSphere.url
	string "vCenter url"
	help
		The vCenter Url

config phase1.vSphere.port
	string "vCenter port"
	default 443
	help
		The vCenter port

config phase1.vSphere.username
	string "vCenter username"
	help
		The vCenter Username

config phase1.vSphere.password
	string "vCenter password"
	help
		The vCenter password

config phase1.vSphere.insecure
	string "Does host use self-signed cert"
	default true
	help
		If the host uses a self-signed cert

config phase1.vSphere.resourcePool
	string "Base Virtual Machine OS Image"
	default "canonical"
	help
		The publisher of the base image used for the VirtualMachines.

config phase1.vSphere.datacenter
	string "Base Virtual Machine OS Image"
	default "datacenter"
	help
		The offer of the base image used for the VirtualMachines.

config phase1.vSphere.datastore
	string "Base Virtual Machine OS Image"
	default "datastore"
	help
		The sku of the base image used for the VirtualMachines.

config phase1.vSphere.vcpu
	string "Number of vcpu"
	default "1"
	help
		Number of vcpu required for VM.


config phase1.vSphere.memory
	string "Memory required for VM"
	default "1024"
	help
		Memory required for VM

config phase1.vSphere.vmdk
	string "Path to vmdk"
	default 443
	help
		VMDK required to boot VMs.

endmenu
```
